## boards/shields/st7789v_generic/Kconfig.defconfig
```kconfig
# Copyright (c) 2024  Callender-Consulting LLC
# SPDX-License-Identifier: Apache-2.0

#--------------------------------------------
#  for nRF52840 boards
#--------------------------------------------
if SHIELD_ST7789V_ALT_NRF52840

if DISPLAY

choice ST7789V_PIXEL_FORMAT
	default ST7789V_RGB565 if SHIELD_ST7789V_ALT_NRF52840
endchoice

if LVGL

config LV_Z_BITS_PER_PIXEL
	default 24 if SHIELD_ST7789V_ALT_NRF52840

endif # LVGL

endif # DISPLAY

endif # SHIELD_ST7789V_ALT_NRF52840

#--------------------------------------------
#  for PICO_W boards
#--------------------------------------------
if SHIELD_ST7789V_ALT_PICO_W

if DISPLAY

choice ST7789V_PIXEL_FORMAT
	default ST7789V_RGB565 if SHIELD_ST7789V_ALT_PICO_W
endchoice

if LVGL

config LV_Z_BITS_PER_PIXEL
	default 24 if SHIELD_ST7789V_ALT_PICO_W

endif # LVGL

endif # DISPLAY

endif # SHIELD_ST7789V_ALT_PICO_W
```

## boards/shields/st7789v_generic/Kconfig.shield
```kconfig
# Copyright (c) 2024  Callender-Consulting LLC 
# SPDX-License-Identifier: Apache-2.0

config SHIELD_ST7789V_ALT_NRF52840
	def_bool $(shields_list_contains,st7789v_alt_nrf52840)

config SHIELD_ST7789V_ALT_PICO_W
	def_bool $(shields_list_contains,st7789v_alt_pico_w)
```
